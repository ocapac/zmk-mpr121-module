## drivers/sensor/mpr121/Kconfig
```kconfig
config MPR121
    bool "MPR121 capacitive touch / proximity sensor"
    depends on I2C && GPIO
    help
      Driver for the Freescale MPR121 capacitive touch and proximity sensor.

config MPR121_LOG_LEVEL
    int "MPR121 log level"
    depends on MPR121
    default 3
    range 0 4
```

## dts/bindings/behaviors/zmk,behavior-mpr121-gestures.yaml
```yaml
description: MPR121 disc gesture behavior
compatible: "zmk,behavior-mpr121-gestures"

include: zero_param.yaml

properties:
  tap-center:
    type: phandle-array
  tap-top:
    type: phandle-array
  tap-bottom:
    type: phandle-array
  tap-left:
    type: phandle-array
  tap-right:
    type: phandle-array
  swipe-up:
    type: phandle-array
  swipe-down:
    type: phandle-array
  swipe-left:
    type: phandle-array
  swipe-right:
    type: phandle-array
  rotary-cw-top:
    type: phandle-array
  rotary-ccw-top:
    type: phandle-array
  rotary-cw-bottom:
    type: phandle-array
  rotary-ccw-bottom:
    type: phandle-array
  rotary-cw-left:
    type: phandle-array
  rotary-ccw-left:
    type: phandle-array
  rotary-cw-right:
    type: phandle-array
  rotary-ccw-right:
    type: phandle-array
```

## dts/bindings/behaviors/zmk,behavior-mpr121-mode-toggle.yaml
```yaml
description: Toggle MPR121 disc between cursor and scroll mode
compatible: "zmk,behavior-mpr121-mode-toggle"

include: zero_param.yaml
```

## dts/bindings/behaviors/zmk,behavior-mpr121-proximity.yaml
```yaml
description: MPR121 proximity behavior
compatible: "zmk,behavior-mpr121-proximity"

include: zero_param.yaml

properties:
  near:
    type: phandle-array
  far:
    type: phandle-array
  sleep:
    type: phandle-array
```

## dts/bindings/sensor/freescale,mpr121.yaml
```yaml
description: Freescale MPR121 capacitive touch / proximity sensor
compatible: "freescale,mpr121"

include: [sensor-device.yaml, i2c-device.yaml]

properties:
  int-gpios:
    type: phandle-array
    required: true

  touch-threshold:
    type: int
    default: 0x08

  release-threshold:
    type: int
    default: 0x05

  prox-touch-threshold:
    type: int
    default: 0x06

  prox-release-threshold:
    type: int
    default: 0x04

  electrode-count:
    type: int
    default: 8

  enable-proximity:
    type: boolean

  debounce:
    type: int
    default: 0x11

  afe-configuration:
    type: int
    default: 0x10

  filter-configuration:
    type: int
    default: 0x20

  auto-config-usl:
    type: int
    default: 0xCA

  auto-config-lsl:
    type: int
    default: 0x83

  auto-config-tl:
    type: int
    default: 0xB4
```

## src/Kconfig
```kconfig
config MPR121_SUBSYSTEM
    bool "MPR121 disc gesture subsystem"
    default y
    depends on MPR121
    select INPUT

config MPR121_TOUCH_THRESHOLD
    int "Touch delta threshold"
    default 100
    depends on MPR121_SUBSYSTEM

config MPR121_DEADZONE
    int "Centre deadzone (x10)"
    default 4
    depends on MPR121_SUBSYSTEM

config MPR121_SWIPE_THRESHOLD
    int "Swipe distance threshold (x10)"
    default 8
    depends on MPR121_SUBSYSTEM

config MPR121_TAP_MAX_DURATION_MS
    int "Max tap duration (ms)"
    default 250
    depends on MPR121_SUBSYSTEM

config MPR121_TAP_MAX_MOVEMENT
    int "Max tap movement (x10)"
    default 5
    depends on MPR121_SUBSYSTEM

config MPR121_ROTARY_THRESHOLD_RAD
    int "Rotary threshold (x100 rad)"
    default 157
    depends on MPR121_SUBSYSTEM

config MPR121_CURSOR_SENSITIVITY
    int "Cursor sensitivity (x10)"
    default 30
    depends on MPR121_SUBSYSTEM
```
